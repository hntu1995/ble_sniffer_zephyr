## CMakeLists.txt
```
cmake_minimum_required(VERSION 3.20.0)

find_package(Zephyr REQUIRED HINTS $ENV{ZEPHYR_BASE})
project(nrf52840_ble_sniffer)

target_sources(app PRIVATE
    src/main.c
    src/radio_sniffer.c
    src/stream.c
)
```

## prj.conf
```kconfig
# nRF52840 SuperMini BLE sniffer
#
# The board (promicro_nrf52840) already enables the new USB device stack and
# a CDC-ACM UART (board_cdc_acm_uart) by default. Keep that enabled and use it
# as the binary packet pipe.

CONFIG_USB_DEVICE_STACK_NEXT=y
CONFIG_CDC_ACM_SERIAL_INITIALIZE_AT_BOOT=y
CONFIG_CDC_ACM_SERIAL_ENABLE_AT_BOOT=y
CONFIG_CDC_ACM_SERIAL_PRODUCT_STRING="nRF52840 BLE Sniffer"
CONFIG_CDC_ACM_SERIAL_MANUFACTURER_STRING="Zephyr"
CONFIG_CDC_ACM_SERIAL_VID=0x2FE3
CONFIG_CDC_ACM_SERIAL_PID=0x0008
CONFIG_UART_LINE_CTRL=y

CONFIG_SERIAL=y
CONFIG_GPIO=y
CONFIG_CLOCK_CONTROL=y

# Logs go to UART0 (P0.09 TX / P0.10 RX, 115200) so the CDC port carries only
# binary frames. The app.overlay moves the console there.
CONFIG_CONSOLE=y
CONFIG_UART_CONSOLE=y
CONFIG_PRINTK=y
CONFIG_LOG=n

CONFIG_MAIN_STACK_SIZE=4096
CONFIG_ASSERT=y
```

## app.overlay
```dts
/*
 * Keep the console off the CDC-ACM port that carries binary sniffer frames.
 * UART0 is broken out on the SuperMini (TX P0.09, RX P0.10).
 */

/ {
	chosen {
		zephyr,console = &uart0;
	};

	aliases {
		/* Provided by the board's boards/common/usb/cdc_acm_serial.dtsi */
		sniffer-uart = &board_cdc_acm_uart;
	};
};
```

## src/main.c
```c
#include <zephyr/kernel.h>
#include <zephyr/device.h>
#include <zephyr/drivers/uart.h>
#include <zephyr/drivers/clock_control.h>
#include <zephyr/drivers/clock_control/nrf_clock_control.h>

#include "radio_sniffer.h"
#include "stream.h"

#define SNIFFER_UART DEVICE_DT_GET(DT_ALIAS(sniffer_uart))

static void wait_for_dtr(const struct device *uart, uint32_t timeout_ms)
{
	int64_t deadline = k_uptime_get() + timeout_ms;

	while (k_uptime_get() < deadline) {
		uint32_t dtr = 0U;

		if (uart_line_ctrl_get(uart, UART_LINE_CTRL_DTR, &dtr) == 0 &&
		    dtr != 0U) {
			return;
		}
		k_sleep(K_MSEC(100));
	}
}

int main(void)
{
	const struct device *uart = SNIFFER_UART;
	const struct device *clock = DEVICE_DT_GET(DT_NODELABEL(clock));

	if (!device_is_ready(uart)) {
		printk("sniffer: CDC-ACM UART is not ready\n");
		return 0;
	}

	/* The radio and TIMER1 both need the 16/32 MHz high-frequency clock. */
	(void)clock_control_on(clock, CLOCK_CONTROL_NRF_SUBSYS_HF);

	sniffer_init();
	stream_init(uart);

	/* Give the host a moment to open the port, then stream regardless. */
	wait_for_dtr(uart, 5000);
	stream_send_hello();

	sniffer_start();

	for (;;) {
		const uint8_t *frame;
		uint16_t len;

		sniffer_tick();

		while (sniffer_dequeue(&frame, &len)) {
			stream_send(frame, len);
		}

		k_sleep(K_MSEC(1));
	}

	return 0;
}
```

## src/radio_sniffer.c
```c
/*
 * BLE advertising sniffer using the nRF52840 RADIO peripheral directly.
 *
 * Phase 1 listens to advertising channels 37/38/39 with a configurable dwell.
 * Register configuration mirrors Zephyr's own BLE controller:
 *   - S0 = LL header byte, LENGTH = PDU length, no S1
 *   - 4-byte access address (3-byte base + 1-byte prefix)
 *   - BLE CRC (3 bytes, address skipped), whitening enabled
 *   - FREQUENCY is the offset from 2400 MHz (ch37=2, ch38=26, ch39=80)
 *
 * The radio writes [LL header][length][payload] to RAM; the firmware prepends
 * the advertising AA and appends three placeholder CRC bytes for Wireshark.
 */

#include <zephyr/kernel.h>
#include <zephyr/irq.h>
#include <zephyr/sys/util.h>
#include <soc.h>
#include <string.h>

#include "radio_sniffer.h"
#include "sniffer_proto.h"

#define RING_SLOTS 64
#define RING_MASK (RING_SLOTS - 1)

struct sniff_slot {
	uint32_t total;
	uint8_t data[SNIFF_MAX_FRAME];
};

static struct sniff_slot ring[RING_SLOTS] __aligned(4);
static volatile uint32_t ring_head;
static volatile uint32_t ring_tail;
static volatile uint32_t drop_count;

/* Radio DMA target: [LL header][length][payload].
 * The extra 4 bytes are defensive padding: some nRF variants/erratas write
 * more than the logical PDU when a length field is corrupted.
 */
static uint8_t pkt_buf[2 + SNIFF_MAX_PDU_LEN + 4] __aligned(4);

static volatile bool rx_active;
static volatile uint8_t cur_channel = 37;
static uint32_t dwell_ms = 10;

static const uint8_t adv_channels[] = {37, 38, 39};
static const uint8_t adv_freq_offset[] = {2, 26, 80}; /* 2400 + x MHz */
static uint32_t hop_index;
static int64_t next_hop_ms;

static void packet_isr(void);

static void radio_clear_events(void)
{
	NRF_RADIO->EVENTS_END = 0;
	NRF_RADIO->EVENTS_ADDRESS = 0;
	NRF_RADIO->EVENTS_CRCOK = 0;
	NRF_RADIO->EVENTS_CRCERROR = 0;
	NRF_RADIO->EVENTS_DISABLED = 0;
}

static void push_packet(uint32_t ts_us, uint8_t rssi_sample, bool crc_ok)
{
	uint32_t plen = pkt_buf[1];
	uint32_t payload_len;
	uint32_t head = ring_head;

	if (plen > SNIFF_MAX_PDU_LEN) {
		return;
	}

	payload_len = 4U + 2U + plen + 3U;

	if ((head - ring_tail) >= RING_SLOTS) {
		drop_count++;
		return;
	}

	struct sniff_slot *slot = &ring[head & RING_MASK];
	struct sniff_frame_hdr *hdr = (struct sniff_frame_hdr *)slot->data;

	hdr->magic[0] = SNIFF_MAGIC0;
	hdr->magic[1] = SNIFF_MAGIC1;
	hdr->version = SNIFF_VERSION;
	hdr->type = SNIFF_TYPE_PACKET;
	hdr->payload_len = (uint16_t)payload_len;
	hdr->timestamp_us = ts_us;
	hdr->channel = cur_channel;
	hdr->rssi_dbm = (int8_t)-(int8_t)(rssi_sample & 0x7FU);
	hdr->flags = SNIFF_FLAG_CRC_CHECKED | SNIFF_FLAG_DEWHITENED |
		     SNIFF_FLAG_AA_VALID;
	if (crc_ok) {
		hdr->flags |= SNIFF_FLAG_CRC_OK;
	}
	hdr->reserved = 0;

	memcpy(&slot->data[SNIFF_HDR_SIZE], SNIFF_ADV_AA, 4);
	/* LL header + length + payload, exactly as received and dewhitened. */
	memcpy(&slot->data[SNIFF_HDR_SIZE + 4], pkt_buf, 2U + plen);
	/* CRC bytes are not written to RAM on RX; Wireshark is told the status. */
	memset(&slot->data[SNIFF_HDR_SIZE + 4 + 2 + plen], 0, 3);

	slot->total = SNIFF_HDR_SIZE + payload_len;
	/* Publish only after the slot is fully written. */
	__DMB();
	ring_head = head + 1U;
}

static void packet_isr(void)
{
	if (NRF_RADIO->EVENTS_END != 0U) {
		bool crc_ok = NRF_RADIO->EVENTS_CRCOK != 0U;
		bool crc_err = NRF_RADIO->EVENTS_CRCERROR != 0U;
		uint8_t rssi_sample;

		NRF_RADIO->EVENTS_END = 0;
		NRF_RADIO->EVENTS_CRCOK = 0;
		NRF_RADIO->EVENTS_CRCERROR = 0;

		/* Capture before doing any work so timestamps stay tight. */
		NRF_TIMER1->TASKS_CAPTURE[0] = 1;
		rssi_sample = (uint8_t)NRF_RADIO->RSSISAMPLE;

		if (crc_ok || crc_err) {
			push_packet(NRF_TIMER1->CC[0], rssi_sample, crc_ok);
		}
	}

	if (NRF_RADIO->EVENTS_DISABLED != 0U) {
		NRF_RADIO->EVENTS_DISABLED = 0;
		if (rx_active) {
			radio_clear_events();
			NRF_RADIO->PACKETPTR = (uint32_t)pkt_buf;
			NRF_RADIO->TASKS_RXEN = 1;
		}
	}
}

static void select_channel(uint8_t channel, uint8_t freq_offset)
{
	unsigned int key = irq_lock();

	rx_active = false;

	if (NRF_RADIO->STATE != 0U) {
		NRF_RADIO->EVENTS_DISABLED = 0;
		NRF_RADIO->TASKS_DISABLE = 1;
		for (volatile int i = 0; i < 20000; i++) {
			if (NRF_RADIO->EVENTS_DISABLED != 0U) {
				break;
			}
		}
		NRF_RADIO->EVENTS_DISABLED = 0;
	}

	cur_channel = channel;
	NRF_RADIO->FREQUENCY = freq_offset;
	NRF_RADIO->DATAWHITEIV = channel;
	NRF_RADIO->PACKETPTR = (uint32_t)pkt_buf;
	radio_clear_events();

	rx_active = true;
	NRF_RADIO->TASKS_RXEN = 1;

	irq_unlock(key);
}

void sniffer_init(void)
{
	/* 1 MHz timer (16 MHz / 2^4), 32-bit, free-running. */
	NRF_TIMER1->TASKS_STOP = 1;
	NRF_TIMER1->TASKS_CLEAR = 1;
	NRF_TIMER1->MODE = TIMER_MODE_MODE_Timer;
	NRF_TIMER1->BITMODE = TIMER_BITMODE_BITMODE_32Bit;
	NRF_TIMER1->PRESCALER = 4;
	NRF_TIMER1->TASKS_START = 1;

	radio_clear_events();

	NRF_RADIO->MODE = (RADIO_MODE_MODE_Ble_1Mbit << RADIO_MODE_MODE_Pos);
	NRF_RADIO->MODECNF0 = (RADIO_MODECNF0_DTX_Center << RADIO_MODECNF0_DTX_Pos);

	/* S0 = 1 byte (LL header), length = 8 bits, no S1, 8-bit preamble. */
	NRF_RADIO->PCNF0 = (1UL << RADIO_PCNF0_S0LEN_Pos) |
			   (8UL << RADIO_PCNF0_LFLEN_Pos) |
			   (0UL << RADIO_PCNF0_S1LEN_Pos) |
			   (0UL << RADIO_PCNF0_PLEN_Pos);

	/* MAXLEN 255, 3-byte base + 1-byte prefix, little endian, whitening. */
	NRF_RADIO->PCNF1 = (SNIFF_MAX_PDU_LEN << RADIO_PCNF1_MAXLEN_Pos) |
			   (0UL << RADIO_PCNF1_STATLEN_Pos) |
			   (3UL << RADIO_PCNF1_BALEN_Pos) |
			   (RADIO_PCNF1_ENDIAN_Little << RADIO_PCNF1_ENDIAN_Pos) |
			   (1UL << RADIO_PCNF1_WHITEEN_Pos);

	NRF_RADIO->TXADDRESS = 0;
	NRF_RADIO->RXADDRESSES = RADIO_RXADDRESSES_ADDR0_Msk;
	NRF_RADIO->BASE0 = 0x89BED600UL; /* 0x8E89BED6, LSB first on air */
	NRF_RADIO->PREFIX0 = 0x8EUL;

	NRF_RADIO->CRCCNF = (3UL << RADIO_CRCCNF_LEN_Pos) |
			    (RADIO_CRCCNF_SKIPADDR_Skip << RADIO_CRCCNF_SKIPADDR_Pos);
	NRF_RADIO->CRCPOLY = 0x00065BUL;
	NRF_RADIO->CRCINIT = 0x555555UL;

	NRF_RADIO->SHORTS = RADIO_SHORTS_READY_START_Msk |
			    RADIO_SHORTS_END_DISABLE_Msk |
			    RADIO_SHORTS_ADDRESS_RSSISTART_Msk |
			    RADIO_SHORTS_DISABLED_RSSISTOP_Msk;

	NRF_RADIO->INTENSET = RADIO_INTENSET_END_Msk |
			      RADIO_INTENSET_DISABLED_Msk;

	IRQ_CONNECT(RADIO_IRQn, 0, packet_isr, NULL, 0);
	irq_enable(RADIO_IRQn);
}

void sniffer_start(void)
{
	hop_index = 0;
	next_hop_ms = k_uptime_get();
}

void sniffer_tick(void)
{
	int64_t now = k_uptime_get();

	if (now >= next_hop_ms) {
		uint32_t idx = hop_index % ARRAY_SIZE(adv_channels);

		select_channel(adv_channels[idx], adv_freq_offset[idx]);
		hop_index++;
		next_hop_ms = now + dwell_ms;
	}
}

bool sniffer_dequeue(const uint8_t **data, uint16_t *len)
{
	uint32_t tail = ring_tail;
	struct sniff_slot *slot;

	if (tail == ring_head) {
		return false;
	}

	/* Make sure the slot contents are visible before reading them. */
	__DMB();
	slot = &ring[tail & RING_MASK];
	*data = slot->data;
	*len = (uint16_t)slot->total;
	ring_tail = tail + 1U;

	return true;
}

uint32_t sniffer_dropped(void)
{
	return drop_count;
}

void sniffer_set_dwell_ms(uint32_t ms)
{
	if (ms >= 1U) {
		dwell_ms = ms;
	}
}
```

## src/radio_sniffer.h
```c
#ifndef RADIO_SNIFFER_H_
#define RADIO_SNIFFER_H_

#include <stdbool.h>
#include <stdint.h>

/** Configure the radio, timer and interrupt. Must be called once. */
void sniffer_init(void);

/** Begin scanning the advertising channels. */
void sniffer_start(void);

/** Advance the channel scheduler. Call from the main loop. */
void sniffer_tick(void);

/**
 * Pop one captured frame.
 *
 * The returned buffer stays valid until 64 further frames have been queued.
 *
 * @return true when a frame was returned.
 */
bool sniffer_dequeue(const uint8_t **data, uint16_t *len);

/** Number of frames dropped because the ring buffer was full. */
uint32_t sniffer_dropped(void);

/** Channel dwell time, default 10 ms. */
void sniffer_set_dwell_ms(uint32_t dwell_ms);

#endif /* RADIO_SNIFFER_H_ */
```

## src/sniffer_proto.h
```c
/*
 * Wire protocol shared by the firmware and the host extcap.
 *
 * All multi-byte fields are little endian.
 */

#ifndef SNIFFER_PROTO_H_
#define SNIFFER_PROTO_H_

#include <stdint.h>

#define SNIFF_MAGIC0 0x5AU
#define SNIFF_MAGIC1 0xC3U
#define SNIFF_VERSION 1U

#define SNIFF_TYPE_PACKET 1U
#define SNIFF_TYPE_HELLO 2U

#define SNIFF_HDR_SIZE 14U

#define SNIFF_MAX_PDU_LEN 255U
/* AA (4) + LL header (1) + length (1) + payload (255) + CRC (3) */
#define SNIFF_MAX_PAYLOAD (4U + 2U + SNIFF_MAX_PDU_LEN + 3U)
#define SNIFF_MAX_FRAME (SNIFF_HDR_SIZE + SNIFF_MAX_PAYLOAD)

#define SNIFF_FLAG_CRC_OK (1U << 0)
#define SNIFF_FLAG_CRC_CHECKED (1U << 1)
#define SNIFF_FLAG_DEWHITENED (1U << 2)
#define SNIFF_FLAG_DIRECTION (1U << 3)
#define SNIFF_FLAG_AA_VALID (1U << 4)
#define SNIFF_FLAG_AUX_ADV (1U << 5)
#define SNIFF_FLAG_TRUNCATED (1U << 6)

struct sniff_frame_hdr {
	uint8_t magic[2];
	uint8_t version;
	uint8_t type;
	uint16_t payload_len;
	uint32_t timestamp_us;
	uint8_t channel;
	int8_t rssi_dbm;
	uint8_t flags;
	uint8_t reserved;
} __packed;

/* Advertising access address as it appears on air (LSB first). */
static const uint8_t SNIFF_ADV_AA[4] = {0xD6, 0xBE, 0x89, 0x8E};

#endif /* SNIFFER_PROTO_H_ */
```

## src/stream.c
```c
#include <zephyr/kernel.h>
#include <zephyr/device.h>
#include <zephyr/drivers/uart.h>
#include <string.h>

#include "stream.h"
#include "sniffer_proto.h"

BUILD_ASSERT(sizeof(struct sniff_frame_hdr) == SNIFF_HDR_SIZE,
	     "wire header must be packed");

static const struct device *cdc_uart;

void stream_init(const struct device *uart)
{
	cdc_uart = uart;
}

void stream_send(const uint8_t *data, size_t len)
{
	if (cdc_uart == NULL) {
		return;
	}

	for (size_t i = 0; i < len; i++) {
		/* Non-blocking: the CDC driver drops bytes when the host is
		 * not reading, which keeps the sniffer loop alive.
		 */
		uart_poll_out(cdc_uart, data[i]);
	}
}

void stream_send_hello(void)
{
	static const char hello[] = "nrf52840-ble-sniffer 1.0.0";
	struct sniff_frame_hdr hdr = {0};

	hdr.magic[0] = SNIFF_MAGIC0;
	hdr.magic[1] = SNIFF_MAGIC1;
	hdr.version = SNIFF_VERSION;
	hdr.type = SNIFF_TYPE_HELLO;
	hdr.payload_len = sizeof(hello) - 1U;

	stream_send((const uint8_t *)&hdr, sizeof(hdr));
	stream_send((const uint8_t *)hello, sizeof(hello) - 1U);
}
```

## src/stream.h
```c
#ifndef STREAM_H_
#define STREAM_H_

#include <stddef.h>
#include <stdint.h>

struct device;

void stream_init(const struct device *uart);

/** Write one already-framed record. Non-blocking (drops if USB TX is full). */
void stream_send(const uint8_t *data, size_t len);

/** Emit the hello frame so the host can confirm the firmware is alive. */
void stream_send_hello(void);

#endif /* STREAM_H_ */
```
